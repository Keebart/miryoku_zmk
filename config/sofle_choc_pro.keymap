// Copyright 2026 Keebart
// SPDX-License-Identifier: MIT

#include "../miryoku/custom_config.h"
#include "../miryoku/mapping/60/sofle.h"
#include "../miryoku/miryoku.dtsi"

/ {
  chosen {
    zmk,physical-layout = &default_layout;
  };
};
