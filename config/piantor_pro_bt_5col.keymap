// Copyright 2026 Keebart
// SPDX-License-Identifier: MIT

#include "../miryoku/custom_config.h"
#include "../miryoku/mapping/36/piantor_pro_bt_5col.h"
#include "../miryoku/miryoku.dtsi"

/ {
  chosen {
    zmk,physical-layout = &five_col_layout;
  };
};
