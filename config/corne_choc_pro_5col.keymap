// Copyright 2026 Keebart
// SPDX-License-Identifier: MIT

#include "../miryoku/custom_config.h"
#include "../miryoku/mapping/40/corne_choc_pro_5col.h"
#include "../miryoku/miryoku.dtsi"

/ {
  chosen {
    zmk,physical-layout = &five_col_layout;
  };
};
